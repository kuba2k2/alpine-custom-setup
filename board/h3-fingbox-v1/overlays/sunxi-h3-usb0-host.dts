/dts-v1/;
/plugin/;

/ {
	fragment@1 {
		target = <&ehci0>;
		__overlay__ {
			status = "okay";
		};
	};
	fragment@2 {
		target = <&ohci0>;
		__overlay__ {
			status = "okay";
		};
	};
	fragment@3 {
		target = <&usb_otg>;
		__overlay__ {
			dr_mode = "host";
		};
	};
};
