## Config.in
```kconfig
source "$BR2_EXTERNAL_ACS_PATH/boot/Config.in"
source "$BR2_EXTERNAL_ACS_PATH/toolchain/Config.in"
source "$BR2_EXTERNAL_ACS_PATH/package/gcc-arm-none-eabi/Config.in.host"
source "$BR2_EXTERNAL_ACS_PATH/package/linux-ssv6051/Config.in"
source "$BR2_EXTERNAL_ACS_PATH/package/linux-tm16xx-display/Config.in"
source "$BR2_EXTERNAL_ACS_PATH/package/mkamlimage/Config.in.host"
source "$BR2_EXTERNAL_ACS_PATH/package/rockchip-mkbootimg/Config.in.host"
source "$BR2_EXTERNAL_ACS_PATH/package/skeleton-alpine/Config.in"
```

## boot/awboot/Config.in
```kconfig
config BR2_TARGET_AWBOOT
	bool "AWBoot"
	help
	  small linux bootloader for Allwinner T113-S3 and V851s

	  https://github.com/szemzoa/awboot

if BR2_TARGET_AWBOOT

config BR2_TARGET_AWBOOT_SOURCE
	string "AWBoot Source"
	default "kuba2k2/awboot"

config BR2_TARGET_AWBOOT_VERSION
	string "AWBoot Version"
	default "9dd108164a107975f8a76b75c335be8d3f488920"

menu "AWBoot binary format"

config BR2_TARGET_AWBOOT_FORMAT_FEL
	bool "awboot-<board>-fel.bin"
	default y
config BR2_TARGET_AWBOOT_FORMAT_SPI
	bool "awboot-<board>-boot-spi.bin"
	default y
config BR2_TARGET_AWBOOT_FORMAT_SD
	bool "awboot-<board>-boot-sd.bin"
config BR2_TARGET_AWBOOT_FORMAT_ALL
	bool "awboot-<board>-boot-all.bin"

config BR2_TARGET_AWBOOT_FORMAT_CUSTOM
	bool "Custom (specify below)"

config BR2_TARGET_AWBOOT_FORMAT_CUSTOM_NAME
	string "AWBoot binary format: custom names"
	depends on BR2_TARGET_AWBOOT_FORMAT_CUSTOM
	help
	  Use space to separate multiple names.
	  Note: specified file names must not contain the board name.

	  E.g. "awboot-fel.bin", not "awboot-myboard-fel.bin".

endmenu

choice
	prompt "AWBoot board name"
	default BR2_TARGET_AWBOOT_BOARD_MANGOPI_DUAL

config BR2_TARGET_AWBOOT_BOARD_MANGOPI_DUAL
	bool "mangopi-dual"

config BR2_TARGET_AWBOOT_BOARD_YUZUKI_LIZARD
	bool "yuzuki-lizard"

config BR2_TARGET_AWBOOT_BOARD_CUSTOM
	bool "Custom/out-of-tree"

endchoice

config BR2_TARGET_AWBOOT_BOARD_CUSTOM_PATH
	string "AWBoot board directory path"
	depends on BR2_TARGET_AWBOOT_BOARD_CUSTOM
	default "$(BR2_EXTERNAL_ACS_PATH)/board/myboardname/awboot"
	help
	  Path to the directory containing board.h and board.c files.

config BR2_TARGET_AWBOOT_BOARD_CUSTOM_NAME
	string "AWBoot board name"
	depends on BR2_TARGET_AWBOOT_BOARD_CUSTOM
	default "myboardname"

endif
```

## configs/atom_d2701_ts_269l_defconfig
```kconfig
BR2_x86_64=y
BR2_TOOLCHAIN_EXTERNAL=y
BR2_TOOLCHAIN_EXTERNAL_CUSTOM=y
BR2_TOOLCHAIN_EXTERNAL_DOWNLOAD=y
BR2_TOOLCHAIN_EXTERNAL_URL="https://master.dl.sourceforge.net/project/gcc-precompiled/gcc-x86_64-linux-4.9.4.tar.gz"
BR2_TOOLCHAIN_EXTERNAL_CUSTOM_PREFIX="$(ARCH)-unknown-linux-gnu"
BR2_TOOLCHAIN_EXTERNAL_GCC_4_9=y
BR2_TOOLCHAIN_EXTERNAL_HEADERS_5_4=y
BR2_TOOLCHAIN_EXTERNAL_CUSTOM_GLIBC=y
BR2_TOOLCHAIN_EXTERNAL_CXX=y
BR2_TOOLCHAIN_EXTERNAL_FORTRAN=y
BR2_OPTIMIZE_S=y
BR2_GLOBAL_PATCH_DIR="$(BR2_EXTERNAL_ACS_PATH)/board/atom-d2701-ts-269l/"
BR2_INIT_NONE=y
BR2_SYSTEM_BIN_SH_NONE=y
BR2_LINUX_KERNEL=y
BR2_LINUX_KERNEL_CUSTOM_TARBALL=y
BR2_LINUX_KERNEL_CUSTOM_TARBALL_LOCATION="file:///work/GPL_QTS/src/linux-3.12.6.tar.gz"
BR2_LINUX_KERNEL_USE_CUSTOM_CONFIG=y
BR2_LINUX_KERNEL_CUSTOM_CONFIG_FILE="$(BR2_EXTERNAL_ACS_PATH)/board/atom-d2701-ts-269l/linux/linux-3.10.108-x86_64.cfg"
# BR2_PACKAGE_BUSYBOX is not set
# BR2_PACKAGE_IFUPDOWN_SCRIPTS is not set
BR2_PACKAGE_WIREGUARD_LINUX_COMPAT=y
BR2_PACKAGE_WIREGUARD_TOOLS=y
# BR2_TARGET_ROOTFS_TAR is not set
```

## configs/exynos4412_i9300_defconfig
```kconfig
BR2_arm=y
BR2_cortex_a9=y
BR2_ARM_ENABLE_NEON=y
BR2_ARM_ENABLE_VFP=y
BR2_ARM_FPU_VFPV3=y
BR2_TOOLCHAIN_EXTERNAL=y
BR2_TOOLCHAIN_EXTERNAL_BOOTLIN=y
BR2_TOOLCHAIN_EXTERNAL_BOOTLIN_ARMV7_EABIHF_MUSL_STABLE=y
BR2_CCACHE=y
BR2_GLOBAL_PATCH_DIR="$(BR2_EXTERNAL_ACS_PATH)/board/exynos4412-i9300/"
BR2_SSP_REGULAR=y
BR2_ROOTFS_SKELETON_ALPINE=y
BR2_ROOTFS_SKELETON_ALPINE_FIRMWARE="brcm cypress synaptics"
BR2_INIT_NONE=y
BR2_ROOTFS_POST_IMAGE_SCRIPT="$(BR2_EXTERNAL_ACS_PATH)/board/exynos4412-i9300/post_image.sh"
BR2_LINUX_KERNEL=y
BR2_LINUX_KERNEL_CUSTOM_VERSION=y
BR2_LINUX_KERNEL_CUSTOM_VERSION_VALUE="6.7"
BR2_LINUX_KERNEL_USE_CUSTOM_CONFIG=y
BR2_LINUX_KERNEL_CUSTOM_CONFIG_FILE="$(BR2_EXTERNAL_ACS_PATH)/board/exynos4412-i9300/linux/.config"
BR2_LINUX_KERNEL_CUSTOM_LOGO_PATH="$(BR2_EXTERNAL_ACS_PATH)/alpine-logo.png"
BR2_LINUX_KERNEL_DTS_SUPPORT=y
BR2_LINUX_KERNEL_INTREE_DTS_NAME="samsung/exynos4412-i9300"
# BR2_PACKAGE_BUSYBOX is not set
# BR2_TARGET_ROOTFS_TAR is not set
BR2_TARGET_UBOOT=y
BR2_TARGET_UBOOT_BUILD_SYSTEM_KCONFIG=y
BR2_TARGET_UBOOT_CUSTOM_GIT=y
BR2_TARGET_UBOOT_CUSTOM_REPO_URL="https://github.com/fourkbomb/u-boot"
BR2_TARGET_UBOOT_CUSTOM_REPO_VERSION="midas-2018.05"
BR2_TARGET_UBOOT_USE_CUSTOM_CONFIG=y
BR2_TARGET_UBOOT_CUSTOM_CONFIG_FILE="$(BR2_EXTERNAL_ACS_PATH)/board/exynos4412-i9300/uboot/.config"
BR2_TARGET_UBOOT_NEEDS_DTC=y
BR2_TARGET_UBOOT_SPL=y
BR2_PACKAGE_HOST_ABOOTIMG=y
BR2_PACKAGE_HOST_DOSFSTOOLS=y
BR2_PACKAGE_HOST_MTOOLS=y
BR2_PACKAGE_HOST_SQUASHFS=y
BR2_PACKAGE_HOST_UBOOT_TOOLS=y
```

## configs/exynos4412_i9300_smdk_defconfig
```kconfig
BR2_arm=y
BR2_cortex_a9=y
BR2_ARM_ENABLE_NEON=y
BR2_ARM_ENABLE_VFP=y
BR2_ARM_FPU_VFPV3=y
BR2_TOOLCHAIN_EXTERNAL=y
BR2_TOOLCHAIN_EXTERNAL_LINARO_2016_02_ARM_LINUX_GNUEABIHF=y
BR2_CCACHE=y
BR2_GLOBAL_PATCH_DIR="$(BR2_EXTERNAL_ACS_PATH)/board/exynos4412-i9300/"
BR2_ROOTFS_SKELETON_ALPINE=y
BR2_INIT_NONE=y
BR2_ROOTFS_POST_IMAGE_SCRIPT="$(BR2_EXTERNAL_ACS_PATH)/board/exynos4412-i9300/post_image_smdk.sh"
BR2_LINUX_KERNEL=y
BR2_LINUX_KERNEL_CUSTOM_GIT=y
BR2_LINUX_KERNEL_CUSTOM_REPO_URL="https://github.com/LineageOS/android_kernel_samsung_smdk4412"
BR2_LINUX_KERNEL_CUSTOM_REPO_VERSION="cm-14.1"
BR2_LINUX_KERNEL_USE_CUSTOM_CONFIG=y
BR2_LINUX_KERNEL_CUSTOM_CONFIG_FILE="$(BR2_EXTERNAL_ACS_PATH)/board/exynos4412-i9300/linux/.config-smdk"
BR2_LINUX_KERNEL_CUSTOM_LOGO_PATH="$(BR2_EXTERNAL_ACS_PATH)/alpine-logo.png"
# BR2_PACKAGE_BUSYBOX is not set
# BR2_TARGET_ROOTFS_TAR is not set
BR2_PACKAGE_HOST_ABOOTIMG=y
BR2_PACKAGE_HOST_DOSFSTOOLS=y
BR2_PACKAGE_HOST_DTC=y
BR2_PACKAGE_HOST_MTOOLS=y
BR2_PACKAGE_HOST_SQUASHFS=y
BR2_PACKAGE_HOST_UBOOT_TOOLS=y
```

## configs/h3_fingbox_v1_defconfig
```kconfig
BR2_arm=y
BR2_cortex_a7=y
BR2_ARM_FPU_NEON_VFPV4=y
BR2_TOOLCHAIN_EXTERNAL=y
BR2_TOOLCHAIN_EXTERNAL_BOOTLIN=y
BR2_TOOLCHAIN_EXTERNAL_BOOTLIN_ARMV7_EABIHF_MUSL_STABLE=y
BR2_OPTIMIZE_S=y
BR2_GLOBAL_PATCH_DIR="$(BR2_EXTERNAL_ACS_PATH)/board/h3-fingbox-v1/"
BR2_ROOTFS_SKELETON_ALPINE=y
BR2_ROOTFS_SKELETON_ALPINE_FIRMWARE="ath9k_htc"
BR2_INIT_NONE=y
BR2_ROOTFS_POST_IMAGE_SCRIPT="$(BR2_EXTERNAL_ACS_PATH)/board/h3-fingbox-v1/post_image.sh"
BR2_LINUX_KERNEL=y
BR2_LINUX_KERNEL_CUSTOM_VERSION=y
BR2_LINUX_KERNEL_CUSTOM_VERSION_VALUE="5.15.160"
BR2_LINUX_KERNEL_USE_CUSTOM_CONFIG=y
BR2_LINUX_KERNEL_CUSTOM_CONFIG_FILE="$(BR2_EXTERNAL_ACS_PATH)/board/h3-fingbox-v1/linux/.config"
BR2_LINUX_KERNEL_CUSTOM_LOGO_PATH="$(BR2_EXTERNAL_ACS_PATH)/alpine-logo.png"
BR2_LINUX_KERNEL_DTS_SUPPORT=y
BR2_LINUX_KERNEL_CUSTOM_DTS_PATH="$(BR2_EXTERNAL_ACS_PATH)/board/h3-fingbox-v1/sun8i-h3-fingbox-v1.dts"
BR2_LINUX_KERNEL_DTB_OVERLAY_SUPPORT=y
# BR2_PACKAGE_BUSYBOX is not set
# BR2_TARGET_ROOTFS_TAR is not set
BR2_TARGET_UBOOT=y
BR2_TARGET_UBOOT_BUILD_SYSTEM_KCONFIG=y
BR2_TARGET_UBOOT_CUSTOM_VERSION=y
BR2_TARGET_UBOOT_CUSTOM_VERSION_VALUE="2023.04"
BR2_TARGET_UBOOT_USE_CUSTOM_CONFIG=y
BR2_TARGET_UBOOT_CUSTOM_CONFIG_FILE="$(BR2_EXTERNAL_ACS_PATH)/board/h3-fingbox-v1/uboot/.config"
BR2_TARGET_UBOOT_NEEDS_DTC=y
BR2_TARGET_UBOOT_NEEDS_PYLIBFDT=y
# BR2_TARGET_UBOOT_FORMAT_BIN is not set
BR2_TARGET_UBOOT_FORMAT_DTB_BIN=y
BR2_TARGET_UBOOT_FORMAT_DTB_IMG=y
BR2_TARGET_UBOOT_FORMAT_CUSTOM=y
BR2_TARGET_UBOOT_SPL=y
BR2_TARGET_UBOOT_SPL_NAME="spl/sunxi-spl.bin"
BR2_TARGET_UBOOT_CUSTOM_DTS_PATH="$(BR2_EXTERNAL_ACS_PATH)/board/h3-fingbox-v1/sun8i-h3-fingbox-v1.dts"
BR2_PACKAGE_HOST_DOSFSTOOLS=y
BR2_PACKAGE_HOST_GENIMAGE=y
BR2_PACKAGE_HOST_MTOOLS=y
BR2_PACKAGE_HOST_SQUASHFS=y
BR2_PACKAGE_HOST_UBOOT_TOOLS=y
```

## configs/rk2926_tac_70072_stock_defconfig
```kconfig
BR2_arm=y
BR2_cortex_a9=y
BR2_ARM_ENABLE_NEON=y
BR2_ARM_ENABLE_VFP=y
BR2_ARM_FPU_VFPV3=y
BR2_TOOLCHAIN_EXTERNAL=y
BR2_TOOLCHAIN_EXTERNAL_LINARO_2016_02_ARM_LINUX_GNUEABIHF=y
BR2_CCACHE=y
BR2_GLOBAL_PATCH_DIR="$(BR2_EXTERNAL_ACS_PATH)/board/rk2926-tac-70072/"
BR2_ROOTFS_SKELETON_ALPINE=y
BR2_INIT_NONE=y
BR2_ROOTFS_POST_IMAGE_SCRIPT="$(BR2_EXTERNAL_ACS_PATH)/board/rk2926-tac-70072/post_image.sh"
BR2_LINUX_KERNEL=y
BR2_LINUX_KERNEL_CUSTOM_GIT=y
BR2_LINUX_KERNEL_CUSTOM_REPO_URL="https://github.com/airikka/denver_tac-70072_kernel"
BR2_LINUX_KERNEL_CUSTOM_REPO_VERSION="0b6d2a2b16666a07d1a622a2f461fae69a65347a"
BR2_LINUX_KERNEL_USE_CUSTOM_CONFIG=y
BR2_LINUX_KERNEL_CUSTOM_CONFIG_FILE="$(BR2_EXTERNAL_ACS_PATH)/board/rk2926-tac-70072/linux/.config-stock"
BR2_LINUX_KERNEL_CUSTOM_LOGO_PATH="$(BR2_EXTERNAL_ACS_PATH)/alpine-logo.png"
# BR2_PACKAGE_BUSYBOX is not set
# BR2_TARGET_ROOTFS_TAR is not set
BR2_PACKAGE_HOST_SQUASHFS=y
BR2_PACKAGE_HOST_UTIL_LINUX=y
BR2_PACKAGE_HOST_ROCKCHIP_MKBOOTIMG=y
```

## configs/s912_h96_pro_plus_defconfig
```kconfig
BR2_aarch64=y
BR2_TOOLCHAIN_EXTERNAL=y
BR2_TOOLCHAIN_EXTERNAL_BOOTLIN=y
BR2_TOOLCHAIN_EXTERNAL_BOOTLIN_AARCH64_MUSL_STABLE=y
BR2_OPTIMIZE_S=y
BR2_GLOBAL_PATCH_DIR="$(BR2_EXTERNAL_ACS_PATH)/board/s912-h96-pro-plus/"
BR2_ROOTFS_SKELETON_ALPINE=y
BR2_ROOTFS_SKELETON_ALPINE_RELEASE="3.23"
BR2_ROOTFS_SKELETON_ALPINE_VERSION="3.23.3"
BR2_ROOTFS_SKELETON_ALPINE_FIRMWARE="ath10k"
BR2_INIT_NONE=y
BR2_ROOTFS_POST_IMAGE_SCRIPT="$(BR2_EXTERNAL_ACS_PATH)/board/s912-h96-pro-plus/post_image.sh"
BR2_LINUX_KERNEL=y
BR2_LINUX_KERNEL_CUSTOM_VERSION=y
BR2_LINUX_KERNEL_CUSTOM_VERSION_VALUE="6.19.3"
BR2_LINUX_KERNEL_USE_CUSTOM_CONFIG=y
BR2_LINUX_KERNEL_CUSTOM_CONFIG_FILE="$(BR2_EXTERNAL_ACS_PATH)/board/s912-h96-pro-plus/linux/.config"
BR2_LINUX_KERNEL_CUSTOM_LOGO_PATH="$(BR2_EXTERNAL_ACS_PATH)/alpine-logo.png"
BR2_LINUX_KERNEL_IMAGEGZ=y
BR2_LINUX_KERNEL_DTS_SUPPORT=y
BR2_LINUX_KERNEL_CUSTOM_DTS_PATH="$(BR2_EXTERNAL_ACS_PATH)/board/s912-h96-pro-plus/meson-gxm-s912-h96-pro-plus.dts $(BR2_EXTERNAL_ACS_PATH)/board/s912-h96-pro-plus/linux/meson-gxm-s912-h96-pro-plus.dtsi"
BR2_LINUX_KERNEL_DTB_OVERLAY_SUPPORT=y
# BR2_PACKAGE_BUSYBOX is not set
# BR2_TARGET_ROOTFS_TAR is not set
BR2_TARGET_UBOOT=y
BR2_TARGET_UBOOT_BUILD_SYSTEM_KCONFIG=y
BR2_TARGET_UBOOT_CUSTOM_VERSION=y
BR2_TARGET_UBOOT_CUSTOM_VERSION_VALUE="2026.01"
BR2_TARGET_UBOOT_USE_CUSTOM_CONFIG=y
BR2_TARGET_UBOOT_CUSTOM_CONFIG_FILE="$(BR2_EXTERNAL_ACS_PATH)/board/s912-h96-pro-plus/uboot/.config"
BR2_TARGET_UBOOT_NEEDS_DTC=y
# BR2_TARGET_UBOOT_FORMAT_BIN is not set
BR2_TARGET_UBOOT_FORMAT_DTB_BIN=y
BR2_TARGET_UBOOT_CUSTOM_DTS_PATH="$(BR2_EXTERNAL_ACS_PATH)/board/s912-h96-pro-plus/meson-gxm-s912-h96-pro-plus.dts $(BR2_EXTERNAL_ACS_PATH)/board/s912-h96-pro-plus/uboot/meson-gxm-s912-h96-pro-plus.dtsi"
BR2_PACKAGE_HOST_AMLOGIC_BOOT_FIP=y
BR2_PACKAGE_HOST_AMLOGIC_BOOT_FIP_DEVICE="khadas-vim"
BR2_PACKAGE_HOST_DOSFSTOOLS=y
BR2_PACKAGE_HOST_GENIMAGE=y
BR2_PACKAGE_HOST_MTOOLS=y
BR2_PACKAGE_HOST_SQUASHFS=y
BR2_PACKAGE_HOST_UBOOT_TOOLS=y
BR2_PACKAGE_HOST_MKAMLIMAGE=y
```

## configs/u8500_golden_defconfig
```kconfig
BR2_arm=y
BR2_cortex_a9=y
BR2_ARM_ENABLE_NEON=y
BR2_ARM_ENABLE_VFP=y
BR2_ARM_FPU_VFPV3=y
BR2_TOOLCHAIN_EXTERNAL=y
BR2_TOOLCHAIN_EXTERNAL_BOOTLIN=y
BR2_TOOLCHAIN_EXTERNAL_BOOTLIN_ARMV7_EABIHF_MUSL_STABLE=y
BR2_CCACHE=y
BR2_GLOBAL_PATCH_DIR="$(BR2_EXTERNAL_ACS_PATH)/board/u8500-golden/"
BR2_SSP_REGULAR=y
BR2_ROOTFS_SKELETON_ALPINE=y
BR2_ROOTFS_SKELETON_ALPINE_FIRMWARE="brcm cypress synaptics"
BR2_INIT_NONE=y
BR2_ROOTFS_POST_IMAGE_SCRIPT="$(BR2_EXTERNAL_ACS_PATH)/board/u8500-golden/post_image.sh"
BR2_LINUX_KERNEL=y
BR2_LINUX_KERNEL_CUSTOM_VERSION=y
BR2_LINUX_KERNEL_CUSTOM_VERSION_VALUE="6.10.3"
BR2_LINUX_KERNEL_USE_CUSTOM_CONFIG=y
BR2_LINUX_KERNEL_CUSTOM_CONFIG_FILE="$(BR2_EXTERNAL_ACS_PATH)/board/u8500-golden/linux/.config"
BR2_LINUX_KERNEL_CUSTOM_LOGO_PATH="$(BR2_EXTERNAL_ACS_PATH)/alpine-logo.png"
BR2_LINUX_KERNEL_DTS_SUPPORT=y
BR2_LINUX_KERNEL_INTREE_DTS_NAME="st/ste-ux500-samsung-golden"
# BR2_PACKAGE_BUSYBOX is not set
# BR2_TARGET_ROOTFS_TAR is not set
BR2_TARGET_UBOOT=y
BR2_TARGET_UBOOT_USE_CUSTOM_CONFIG=y
BR2_TARGET_UBOOT_CUSTOM_CONFIG_FILE="$(BR2_EXTERNAL_ACS_PATH)/board/u8500-golden/uboot/.config"
BR2_TARGET_UBOOT_NEEDS_DTC=y
BR2_PACKAGE_HOST_ABOOTIMG=y
BR2_PACKAGE_HOST_DOSFSTOOLS=y
BR2_PACKAGE_HOST_MTOOLS=y
BR2_PACKAGE_HOST_SQUASHFS=y
BR2_PACKAGE_HOST_UBOOT_TOOLS=y
```

## package/gcc-arm-none-eabi/Config.in.host
```kconfig
config BR2_PACKAGE_HOST_GCC_ARM_NONE_EABI
bool "host gcc-arm-none-eabi"
	help
	  xPack GNU Arm Embedded GCC

	  https://github.com/xpack-dev-tools/arm-none-eabi-gcc-xpack

if BR2_PACKAGE_HOST_GCC_ARM_NONE_EABI

config BR2_PACKAGE_HOST_GCC_ARM_NONE_EABI_VERSION
	string "xPack GNU Arm Embedded GCC Version"
	default "10.3.1-2.2"

endif
```

## package/linux-ssv6051/Config.in
```kconfig
config BR2_PACKAGE_LINUX_SSV6051
	bool "linux ssv6051"
	depends on BR2_LINUX_KERNEL
	help
		South Silicon Valley (ssv) 6051 family WLAN support

		https://github.com/armbian/build/blob/4ccaf7e/patch/kernel/archive/rockchip-6.19/patches.armbian/wifi-driver-ssv6051.patch
```

## package/linux-tm16xx-display/Config.in
```kconfig
config BR2_PACKAGE_LINUX_TM16XX_DISPLAY
	bool "linux tm16xx-display"
	depends on BR2_LINUX_KERNEL
	help
		Linux kernel driver for auxiliary displays based on led controllers such as tm16xx family and alike

		https://github.com/jefflessard/tm16xx-display
```

## package/mkamlimage/Config.in.host
```kconfig
config BR2_PACKAGE_HOST_MKAMLIMAGE
	bool "host mkamlimage"
	help
		Amlogic Upgrade Package creation/extraction tool

		https://github.com/kuba2k2/mkamlimage
```

## package/rockchip-mkbootimg/Config.in.host
```kconfig
config BR2_PACKAGE_HOST_ROCKCHIP_MKBOOTIMG
	bool "host rockchip-mkbootimg"
	help
		Tools to create firmware / boot images for Rockchip devices

		https://github.com/neo-technologies/rockchip-mkbootimg
```

## package/skeleton-alpine/Config.in
```kconfig
config BR2_PACKAGE_SKELETON_ALPINE
	bool
	select BR2_PACKAGE_HAS_SKELETON

config BR2_PACKAGE_PROVIDES_SKELETON
	default "skeleton-alpine" if BR2_PACKAGE_SKELETON_ALPINE
```

## toolchain/Config.in
```kconfig
source "$BR2_EXTERNAL_ACS_PATH/toolchain/toolchain-external-linaro-2016.02-arm-linux-gnueabihf/Config.in.options"
```
